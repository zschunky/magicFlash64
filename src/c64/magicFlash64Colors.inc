; 
; Copyright (c) 2019 Andreas Zschunke
; 
; This program is free software: you can redistribute it and/or modify
; it under the terms of the GNU General Public License as published by
; the Free Software Foundation, either version 3 of the License, or
; (at your option) any later version.
; 
; This program is distributed in the hope that it will be useful,
; but WITHOUT ANY WARRANTY; without even the implied warranty of
; MERCHANTABILITY or FITNESS FOR A PARTICULAR PURPOSE.  See the
; GNU General Public License for more details.
; 
; You should have received a copy of the GNU General Public License
; along with this program.  If not, see <http://www.gnu.org/licenses/>.
; 

.define BLACK       0
.define WHITE       1
.define RED         2
.define CYAN        3
.define VIOLET      4
.define GREEN       5
.define BLUE        6
.define YELLOW      7
.define ORANGE      8
.define BROWN       9
.define PINK        10
.define DARK_GREY   11
.define GREY        12
.define LIGHT_GREEN 13
.define LIGHT_BLUE  14
.define LIGHT_GREY  15


.define COLOR_BACKGROUND BLUE
.define COLOR_BORDER     CYAN
.define COLOR_TITLE      LIGHT_GREY
.define COLOR_FW         GREY
.define COLOR_HELP       WHITE
.define COLOR_FRAME      WHITE
.define COLOR_DISABLED   LIGHT_GREY

.define COLOR_SELECTED   YELLOW
.define COLOR_BASIC      LIGHT_GREEN
.define COLOR_KERNAL     WHITE
.define COLOR_PRG        CYAN
.define COLOR_CART       PINK
.define COLOR_MENU       GREEN
.define COLOR_EMPTY      LIGHT_BLUE
.define COLOR_FOLLOWUP   LIGHT_GREY

.define COLOR_MENU_KERNAL WHITE
.define COLOR_MENU_CART   WHITE
